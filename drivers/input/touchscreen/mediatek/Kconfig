## drivers/input/touchscreen/mediatek/Kconfig
```kconfig
#
# Touchscreen driver configuration
#
menuconfig INPUT_TOUCHSCREEN
	bool "Touchscreens"
	help
	  Say Y here, and a list of supported touchscreens will be displayed.
	  This option doesn't affect the kernel.

	  If unsure, say Y.

if INPUT_TOUCHSCREEN

config TOUCHSCREEN_MTK
	bool "MediaTek Touch Panel Driver"
	help
	  Say Y here if you have MediaTek touch panel.

	  If unsure, say N.

	  To compile this dirver as a module, choose M here: the
	  module will be called.
config MTK_TGESTURE
        bool "tGesture for Mediatek package"
        default n
config TOUCHSCREEN_MTK_EKTF2K
        bool "ektf2k for Mediatek package"
        default n

config TOUCHSCREEN_MTK_EKTF2K_V3702
        bool "ektf2k for Mediatek package"
        default n

config TOUCHSCREEN_MTK_EKTF2K_P4200
        bool "ektf2k for Mediatek package"
        default n
config TOUCHSCREEN_MTK_EKTF2K_V2500
        bool "ektf2k for Mediatek package"
        default n
config TOUCHSCREEN_MTK_FT6336
        bool "FT6336 for Mediatek package"
        default n
config TOUCHSCREEN_MTK_FT6336_V2500
        bool "FT6336 for Mediatek package"
        default n

config TOUCHSCREEN_MTK_FT6336_P4200
        bool "FT6336 P4200 for Mediatek package"
        default n

config TOUCHSCREEN_MTK_FT5346I_V3750
       bool "FT5346I for Mediatek package"
       default n

config TOUCHSCREEN_SYNAPTICS_S5250
        bool "synaptics 5250 for Mediatek package"
        default n
config TOUCHSCREEN_MTK_S2333_V3750
        bool "synaptics v3750 for Mediatek package"
        default n
config TOUCHSCREEN_MTK_GT1151
	bool "GT1151 for Mediatek package"
	default n
	help
	  Say Y here if you have GT1151 touch panel.

	  If unsure, say N.

	  To compile this dirver as a module, choose M here: the
	  module will be called.

source "drivers/input/touchscreen/mediatek/GT1151/Kconfig"

config TOUCHSCREEN_MTK_GT928
	tristate "GT928 Touchscreen"
	help
	  Say Y here if you have Goodix GT928 touchscreen,
	  connected to your system.
	  If unsure, say N.
	  To compile this driver as a module, choose M here.
config TOUCHSCREEN_MTK_GT9XXTB_HOTKNOT
	bool "GT9XXTB hotknot for Mediatek package"
	default n
	help
	  Say Y here if you have GT9xx touch panel.

	  If unsure, say N.

	  To compile this dirver as a module, choose M here: the
	  module will be called.

source "drivers/input/touchscreen/mediatek/GT9XXTB_hotknot/Kconfig"

config TOUCHSCREEN_MTK_SYNAPTICS_I2C_RMI4
	tristate "Synaptics DSX I2C touchscreen"
	depends on I2C
	help
	  Say Y here if you have a Synaptics DSX I2C touchscreen
	  connected to your system.

	  If unsure, say N.

	  To compile this driver as a module, choose M here: the
	  module will be called synaptics_i2c_rmi4.

source "drivers/input/touchscreen/mediatek/synaptics_i2c_rmi4/Kconfig"

config TOUCHSCREEN_MTK_GT910
	bool "GT910 for Mediatek package"
	default n
	help
	  Say Y here if you have GT910 touch panel.

	  If unsure, say N.

	  To compile this dirver as a module, choose M here: the
	  module will be called.

source "drivers/input/touchscreen/mediatek/GT910/Kconfig"

config TOUCHSCREEN_MTK_GT9XX_HOTKNOT_SCP
	bool "GT9XX_HOTKNOT_SCP for Mediatek package"
	default n
	help
	  Say Y here if you have GT9XX_HOTKNOT_SCP touch panel.

	  If unsure, say N.

	  To compile this dirver as a module, choose M here: the
	  module will be called.

source "drivers/input/touchscreen/mediatek/GT9XX_hotknot_scp/Kconfig"

config TOUCHSCREEN_MTK_GT911
	bool "GT911 for Mediatek package"
	default n
	help
	  Say Y here if you have GT911 touch panel.

	  If unsure, say N.

	  To compile this dirver as a module, choose M here: the
	  module will be called.

source "drivers/input/touchscreen/mediatek/GT911/Kconfig"

config TOUCHSCREEN_MTK_FT5X0X
	bool "FT5X0X for Mediatek package"
	default n
	help
	  Say Y here if you have FT5X0X touch panel.

	  If unsure, say N.

	  To compile this dirver as a module, choose M here: the
	  module will be called.

source "drivers/input/touchscreen/mediatek/ft5x0x/Kconfig"

endif
```

## drivers/misc/mediatek/accelerometer/bma056/Kconfig
```kconfig
config MTK_BMA056
	bool "MTK_MTK_BMA056 for MediaTek package"
	default n
	help
	  It support different accelerometer sensor.
          If this option is set,
	  it will support
          MTK_MTK_BMA056 Accelerometer.
```

## drivers/misc/mediatek/alsps/epl2570/Kconfig
```kconfig
config MTK_EPL2570
	bool "epl2570 for MediaTek package"
	default n
	help
	It support different type sensor
	in this platform. If this option
	is set, it will support ambient
	and light sensor epl2570.
```

## drivers/misc/mediatek/alsps/ltr553/Kconfig
```kconfig
config MTK_LTR553
	bool "ltr553 for MediaTek package"
	default n
	help
	It support different type sensor
	in this platform. If this option
	is set, it will support ambient
	and light sensor ltr553.
```

## drivers/misc/mediatek/alsps/stk3308/Kconfig
```kconfig
config MTK_STK3308
	bool "ltr553 for MediaTek package"
	default n
	help
	It support different type sensor
	in this platform. If this option
	is set, it will support ambient
	and light sensor ltr553.
```

## drivers/misc/mediatek/alsps_sub/ltr553_sub/Kconfig
```kconfig
config MTK_LTR553_SUB
	bool "ltr553 sub for MediaTek package"
	default n
	help
	It support different type sensor
	in this platform. If this option
	is set, it will support ambient
	and light sensor ltr553.
```

## drivers/misc/mediatek/magnetometer/bmm056-new/Kconfig
```kconfig
config MTK_BMM056_NEW
	bool "BMM056 for MediaTek package"
	default n
	help
	  It support different magnetometer sensor.
          If this option is set,
	  it will support
          BMM056 magnetometer.
```
